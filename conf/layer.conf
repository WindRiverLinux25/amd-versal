## conf/machine/amd-versal-basic.inc
```bitbake
DEFAULTTUNE = "cortexa72"

require conf/machine/include/arm/armv8a/tune-cortexa72.inc

MACHINE_FEATURES += "ext3 pci usbgadget usbhost vfat keyboard network"
```

## conf/machine/amd-versal-sdt.inc
```bitbake
WORKFLOW_MACHINE_NAME ??= ""

MACHINE_CONF = "${@'${WORKFLOW_MACHINE_NAME}.conf' if d.getVar("WORKFLOW_MACHINE_NAME") != "" else 'versal-${VERSAL_TARGET_BOARD}-sdt-seg.conf'}"

require conf/machine/${MACHINE_CONF}
```

## conf/machine/amd-versal-xsct.inc
```bitbake
WORKFLOW_MACHINE_NAME ??= ""

MACHINE_CONF = "${@'${WORKFLOW_MACHINE_NAME}.conf' if d.getVar("WORKFLOW_MACHINE_NAME") != "" else '${VERSAL_TARGET_BOARD}-versal.conf'}"

require conf/machine/${MACHINE_CONF}
```

## conf/machine/amd-versal.conf
```bitbake
#@TYPE: Machine
#@NAME: amd-versal
#@DESCRIPTION: Machine configuration for AMD Versal

VERSAL_TARGET_BOARD ?= "vck190"
require ${@bb.utils.contains('DISTRO_FEATURES', 'xilinx-bootloader', \
			'conf/machine/amd-versal-sdt.inc', \
			'conf/machine/amd-versal-basic.inc', d)}

BSP_XILINX_DERIVED:append = " amd-versal"

KERNEL_IMAGETYPE = "Image"
XILINX_DTB_FILES = " versal-vck190-rev1.1.dtb versal-vck190-rev1.1-x-ebm-01-revA.dtb \
						versal-vmk180-rev1.1.dtb versal-vmk180-rev1.1-x-ebm-01-revA.dtb"

KERNEL_DEVICETREE = "${@''.join('xilinx/%s ' % d for d in '${XILINX_DTB_FILES}'.split())}"

PREFERRED_PROVIDER_virtual/kernel ??= "linux-yocto"
PREFERRED_VERSION_linux-yocto ?= "6.12%"
PREFERRED_VERSION_linux-yocto-rt ?= "6.12%"

MACHINE_EXTRA_RRECOMMENDS = " kernel-modules kernel-devicetree"
IMAGE_FSTYPES += "tar.bz2 wic wic.bmap ext4 tar.gz"

# wic support
WKS_FILE = "versal-sdimage.wks"
do_image_wic[depends] += "mtools-native:do_populate_sysroot dosfstools-native:do_populate_sysroot"
IMAGE_BOOT_FILES ?= " Image ${XILINX_DTB_FILES} "

# multilib support
MULTILIBS ?= "${@bb.utils.contains_any('DISTRO_FEATURES', 'xrt', '', 'multilib:lib32', d)}"
DEFAULTTUNE:virtclass-multilib-lib32 ?= "armv7athf-neon"
EXTRA_IMAGECMD:jffs2 = "--pad --no-cleanmarkers --eraseblock=128"
```
